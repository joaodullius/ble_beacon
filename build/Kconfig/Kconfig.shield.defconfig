## build/Kconfig/Kconfig.shield.defconfig
```kconfig
osource "C:/Work/NCS/v1.5.0/nrf/boards/shields/*/Kconfig.defconfig"
osource "C:/Work/NCS/v1.5.0/zephyr/boards/shields/*/Kconfig.defconfig"
osource "C:/Work/NCS/v1.5.0/zephyr/boards/shields/*/Kconfig.defconfig"
```
